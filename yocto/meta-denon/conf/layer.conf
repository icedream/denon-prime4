## yocto/meta-denon/conf/layer.conf
```bitbake
# Layer configuration for meta-denon
# This layer provides recipes and configurations for Denon DJ PRIME 4

BBPATH .= ":${LAYERDIR}"

LAYERSERIES_COMPAT_meta-denon = "scarthgap"

LAYERVERSION_meta-denon = "1.0"

DESCRIPTION = "Yocto layer for Denon DJ PRIME 4 (AZ01)"

LICENSE = "MIT"

LIC_FILES_CHKSUM = "file://${COMMON_LICENSE_DIR}/MIT;md5=0835ade698e0bcf8506ecda2f7b4f302"

# Include recipes from this layer
BBFILES += "${LAYERDIR}/recipes-*/*/*.bb \
            ${LAYERDIR}/recipes-*/*/*.bbappend"

BBFILE_COLLECTIONS += "meta-denon"
BBFILE_PATTERN_meta-denon = "^${LAYERDIR}/"
BBFILE_PRIORITY_meta-denon = "6"

# Dependencies
require conf/distro/include/default-distrovars.inc

# MACHINE configurations
# Supported machines:
#   az01 - Denon DJ PRIME 4 (JC11)
```
