## buildroot-customizations/Config.in
```kconfig
source "$BR2_EXTERNAL_MIXXX_PATH/package/chromaprint/Config.in"
source "$BR2_EXTERNAL_MIXXX_PATH/package/mixxx/Config.in"
source "$BR2_EXTERNAL_MIXXX_PATH/package/portmidi/Config.in"
```

## buildroot-customizations/configs/inmusic_az01_mixxx_defconfig
```kconfig
BR2_arm=y
BR2_cortex_a17=y
BR2_ARM_FPU_VFPV4=y
BR2_ARM_INSTRUCTIONS_THUMB2=y
BR2_CPAN_MIRROR="http://cpan.metacpan.org"
# BR2_PIC_PIE is not set
BR2_SSP_NONE=y
BR2_RELRO_NONE=y
BR2_FORTIFY_SOURCE_NONE=y
BR2_TOOLCHAIN_BUILDROOT_GLIBC=y
BR2_KERNEL_HEADERS_VERSION=y
BR2_DEFAULT_KERNEL_VERSION="5.15.115"
BR2_PACKAGE_HOST_LINUX_HEADERS_CUSTOM_5_15=y
BR2_BINUTILS_VERSION_2_35_X=y
BR2_GCC_VERSION_11_X=y
BR2_TOOLCHAIN_BUILDROOT_CXX=y
BR2_INIT_SYSTEMD=y
BR2_TARGET_GENERIC_ROOT_PASSWD="denonprime4"
BR2_SYSTEM_DEFAULT_PATH="/bin:/sbin:/usr/bin:/usr/sbin"
BR2_ROOTFS_OVERLAY="board/inmusic/az01/common/rootfs_overlay"
BR2_PACKAGE_FAAD2=y
BR2_PACKAGE_DEJAVU=y
BR2_PACKAGE_QT5=y
BR2_PACKAGE_QT5BASE_SQLITE_QT=y
BR2_PACKAGE_QT5BASE_OPENGL_ES2=y
BR2_PACKAGE_QT5BASE_LINUXFB=y
BR2_PACKAGE_QT5BASE_EGLFS=y
BR2_PACKAGE_QT5BASE_DEFAULT_QPA="eglfs"
BR2_PACKAGE_QT5BASE_FONTCONFIG=y
BR2_PACKAGE_XORG7=y
BR2_PACKAGE_XSERVER_XORG_SERVER=y
BR2_PACKAGE_XLIB_LIBXAW=y
BR2_PACKAGE_XLIB_LIBXTST=y
BR2_PACKAGE_XDRIVER_XF86_INPUT_KEYBOARD=y
BR2_PACKAGE_XDRIVER_XF86_INPUT_LIBINPUT=y
BR2_PACKAGE_MALI_T76X=y
BR2_PACKAGE_LIBEBUR128=y
BR2_PACKAGE_LIBSOUNDTOUCH=y
BR2_PACKAGE_MP4V2=y
BR2_PACKAGE_LIBTHEORA=y
BR2_PACKAGE_BOOST=y
BR2_PACKAGE_BOOST_TIMER=y
BR2_PACKAGE_OPENSSH=y
# BR2_PACKAGE_OPENSSH_CLIENT is not set
BR2_PACKAGE_LIBKEYFINDER=y
BR2_PACKAGE_MIXXX=y
BR2_PACKAGE_MIXXX_SUPPORT_KEYFINDER_STATIC=y
BR2_PACKAGE_RUBBERBAND_RESAMPLER_LIBSAMPLERATE=y
```

## buildroot-customizations/configs/inmusic_az01_openssh_defconfig
```kconfig
BR2_arm=y
BR2_cortex_a17=y
BR2_ARM_FPU_VFPV4=y
BR2_ARM_INSTRUCTIONS_THUMB2=y
BR2_CPAN_MIRROR="http://cpan.metacpan.org"
# BR2_PIC_PIE is not set
BR2_SSP_NONE=y
BR2_RELRO_NONE=y
BR2_FORTIFY_SOURCE_NONE=y
BR2_TOOLCHAIN_BUILDROOT_GLIBC=y
BR2_KERNEL_HEADERS_VERSION=y
BR2_DEFAULT_KERNEL_VERSION="5.15.115"
BR2_PACKAGE_HOST_LINUX_HEADERS_CUSTOM_5_15=y
BR2_BINUTILS_VERSION_2_35_X=y
BR2_GCC_VERSION_9_X=y
BR2_INIT_SYSTEMD=y
BR2_TARGET_GENERIC_ROOT_PASSWD="denonprime4"
BR2_SYSTEM_DEFAULT_PATH="/bin:/sbin:/usr/bin:/usr/sbin"
BR2_PACKAGE_MALI_T76X=y
BR2_PACKAGE_OPENSSH=y
# BR2_PACKAGE_OPENSSH_CLIENT is not set
```

## buildroot-customizations/package/chromaprint/Config.in
```kconfig
config BR2_PACKAGE_CHROMAPRINT
    bool "chromaprint"
    help
        Installs Chromaprint, a C library for generating audio fingerprints used by AcoustID.
```

## buildroot-customizations/package/libkeyfinder/Config.in
```kconfig
config BR2_PACKAGE_LIBKEYFINDER
    bool "libkeyfinder"
    help
        Installs libkeyfinder, a small C++11 library for estimating the musical key of digital
        audio.
    depends on BR2_PACKAGE_FFTW
    depends on BR2_PACKAGE_FFTW_DOUBLE
```

## buildroot-customizations/package/lilv/Config.in
```kconfig
config BR2_PACKAGE_LILV
    bool "lilv"
    select BR2_PACKAGE_LV2
    select BR2_PACKAGE_SERD
    help
        Installs lilv, a host library for LV2 plugins.
```

## buildroot-customizations/package/lv2/Config.in
```kconfig
config BR2_PACKAGE_LV2
    bool "lv2"
    help
        Installs lv2, a host library for LV2 plugins.
```

## buildroot-customizations/package/mixxx/Config.in
```kconfig
config BR2_PACKAGE_MIXXX
    bool "mixxx"
    depends on BR2_PACKAGE_FFMPEG || BR2_PACKAGE_FFTW_DOUBLE # chromaprint
    depends on BR2_PACKAGE_HAS_UDEV # hidapi
    depends on BR2_PACKAGE_QT5
    depends on BR2_PACKAGE_QT5_JSCORE_AVAILABLE # qt5declarative
    select BR2_PACKAGE_CHROMAPRINT
    select BR2_PACKAGE_FAAD2
    select BR2_PACKAGE_FLAC
    select BR2_PACKAGE_LAME
    select BR2_PACKAGE_HIDAPI
    select BR2_PACKAGE_LIBID3TAG
    select BR2_PACKAGE_LIBOGG
    select BR2_PACKAGE_LIBMAD
    select BR2_PACKAGE_LIBSHOUT
    select BR2_PACKAGE_LIBSNDFILE
    select BR2_PACKAGE_LIBTHEORA
    select BR2_PACKAGE_LIBUSB
    select BR2_PACKAGE_MP4V2
    select BR2_PACKAGE_MPG123
    select BR2_PACKAGE_OPUSFILE
    select BR2_PACKAGE_PORTAUDIO
    select BR2_PACKAGE_PORTMIDI
    select BR2_PACKAGE_PROTOBUF
    select BR2_PACKAGE_QT5BASE_GUI
    select BR2_PACKAGE_QT5BASE_XCB
    select BR2_PACKAGE_QT5DECLARATIVE
    select BR2_PACKAGE_QT5DECLARATIVE_QUICK
    select BR2_PACKAGE_QT5QUICKCONTROLS
    select BR2_PACKAGE_QT5QUICKCONTROLS2
    select BR2_PACKAGE_QT5SCRIPT
    select BR2_PACKAGE_QT5SVG
    select BR2_PACKAGE_QT5X11EXTRAS
    select BR2_PACKAGE_SQLITE
    select BR2_PACKAGE_TAGLIB
    select BR2_PACKAGE_UPOWER
    select BR2_PACKAGE_WAVPACK
    help
        Installs Mixxx, an open-source DJ software.

comment "mixxx needs QT5 with declarative module for its JavaScript engine"
    depends on !BR2_PACKAGE_QT5_JSCORE_AVAILABLE || !BR2_PACKAGE_QT5

comment "mixxx needs hidapi/udev for talking to devices directly"
    depends on !BR2_PACKAGE_HAS_UDEV
```

## buildroot-customizations/package/msgsl/Config.in
```kconfig
config BR2_PACKAGE_MSGSL
    bool "Microsoft GSL"
    help
        Installs Microsoft Guidelines Support Library.
```

## buildroot-customizations/package/portmidi/Config.in
```kconfig
config BR2_PACKAGE_PORTMIDI
    bool "portmidi"
    help
        Installs portmidi, a cross-platform MIDI input/output library.
```

## buildroot-customizations/package/qtkeychain/Config.in
```kconfig
config BR2_PACKAGE_QTKEYCHAIN
    bool "QtKeychain"
    depends on BR2_PACKAGE_QT5BASE
    depends on BR2_TOOLCHAIN_HAS_THREADS # qt5dbus
    depends on BR2_USE_MMU # qt5dbus
    select BR2_PACKAGE_LIBSECRET
    select BR2_PACKAGE_QT5BASE_DBUS
    select BR2_PACKAGE_QT5TOOLS
    select BR2_PACKAGE_QT5TOOLS_LINGUIST_TOOLS
    help
        Installs QtKeychain, a Qt API to store passwords and other secret data securely.

comment "QtKeychain needs toolchain w/ threads"
    depends on BR2_USE_MMU
    depends on !BR2_TOOLCHAIN_HAS_THREADS
```

## buildroot-customizations/package/rubberband/Config.in
```kconfig
config BR2_PACKAGE_RUBBERBAND
    bool "rubberband"
    help
        Installs rubberband, an audio time-stretching and pitch-shifting library and utility program.

if BR2_PACKAGE_RUBBERBAND

choice
    prompt "Rubberband FFT"
    default BR2_PACKAGE_RUBBERBAND_FFT_BUILTIN
    help
        The choice of FFT library makes no difference to output quality, only to
        processing speed.

config BR2_PACKAGE_RUBBERBAND_FFT_BUILTIN
    bool "Built-in"
    help
        Default.

config BR2_PACKAGE_RUBBERBAND_FFT_FFTW
    bool "FFTW"
    depends on BR2_PACKAGE_FFTW
    help
        A bit faster than built-in. GPL licence.

comment "FFTW needs one of the FFTW options to be selected"
    depends on !BR2_PACKAGE_FFTW

config BR2_PACKAGE_RUBBERBAND_FFT_KISSFFT
    bool "KissFFT"
    select BR2_PACKAGE_KISSFFT
    help
        Single precision. Only advisable when using single-precision sample type
        (see below). BSD-ish licence.

# TODO - vDSP?
# TODO - SLEEF

endchoice

choice
    prompt "Rubberband Resampler"
    default BR2_PACKAGE_RUBBERBAND_RESAMPLER_BUILTIN
    help
        The choice of resampler affects both output quality, when
        pitch-shifting, and CPU usage.

config BR2_PACKAGE_RUBBERBAND_RESAMPLER_BUILTIN
    bool "Built-in"
    help
        Default. Intended to give high quality for time-varying pitch shifts in
        real-time mode. Not the fastest option.

config BR2_PACKAGE_RUBBERBAND_RESAMPLER_LIBSAMPLERATE
    bool "libsamplerate"
    select BR2_PACKAGE_LIBSAMPLERATE
    help
        Good choice in most cases. High quality and usually a bit faster than
        the built-in option. BSD-ish licence.

# TODO - libspeexdsp
# TODO - Bundled Speex, but should be avoided for new projects anyways.

endchoice

endif
```

## buildroot-customizations/package/serd/Config.in
```kconfig
config BR2_PACKAGE_SERD
    bool "serd"
    help
        Installs serd, a lightweight C library for RDF syntax which supports reading and writing Turtle, TRiG, NTriples, and NQuads.
```

## buildroot-customizations/package/sord/Config.in
```kconfig
config BR2_PACKAGE_SORD
    bool "sord"
    help
        Installs serd, a lightweight C library for storing RDF statements in memory.
```

## buildroot-customizations/package/sratom/Config.in
```kconfig
config BR2_PACKAGE_SRATOM
    bool "sratom"
    help
        Installs sratom, a small library for serialising LV2 atoms to and from RDF, for converting between binary and text or storing in a model.
```
